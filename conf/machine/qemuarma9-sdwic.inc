## conf/machine/qemuarma9-sdwic.inc
```bitbake
# FIXME getting wic to be 1GiB exactly so qemu doesn't complain
# https://docs.yoctoproject.org/ref-manual/variables.html#term-IMAGE_POSTPROCESS_COMMAND
IMAGE_POSTPROCESS_COMMAND += "resize_wic;"
resize_wic() {
  qemu-img resize -f raw ${IMGDEPLOYDIR}/${IMAGE_NAME}${IMAGE_NAME_SUFFIX}.wic 1G
}
```

## conf/machine/qemuarma9.conf
```bitbake
#@TYPE: Machine
#@NAME: qemuarma9
#@DESCRIPTION: a9 vexpress

require qemuarma9.inc
require qemuarma9-sdwic.inc
require conf/machine/include/qemu.inc
DEFAULTTUNE ?= "armv7at"
# require conf/machine/include/arm/armv7a/tune-cortexa9.inc honister+
require conf/machine/include/tune-cortexa9.inc

KERNEL_IMAGETYPE = "zImage"

SERIAL_CONSOLES ?= "115200;ttyAMA0 115200;ttyAMA1"

EXTRA_IMAGEDEPENDS += "u-boot"
UBOOT_MACHINE ?= "vexpress_ca9x4_defconfig"
# Include u-boot elf file in the images folder so qemu can use it as -kernel arg
UBOOT_ELF ?= "u-boot"
UBOOT_ENTRYPOINT ?= "0x60010000"
UBOOT_LOADADDRESS ?= "0x60010000"
# Needed to skip particular QA checks that don't apply to U-boot's binary.
INSANE_SKIP:u-boot += "ldflags textrel"

IMAGE_FSTYPES += "wic"
WKS_FILE ?= "qemuarma9-yocto.wks"
IMAGE_BOOT_FILES ?= "zImage vexpress-v2p-ca9.dtb"

# For runqemu
QB_SYSTEM_NAME ?= "qemu-system-arm"
QB_MACHINE ?= "-machine vexpress-a9"
QB_KERNEL_CMDLINE_APPEND ?= "console=ttyAMA0,115200 console=tty"
# vexpress does not have any PCI bus to support virtio-rng-pci,
# We define specific virtio block device for it.
QB_DEFAULT_KERNEL ?= "u-boot.elf"
QB_DEFAULT_FSTYPE ?= "wic"
QB_FSINFO ?= "wic:no-kernel-in-fs"
QB_ROOTFS_OPT ?= "-drive id=disk0,file=@ROOTFS@,if=sd,format=raw"
QB_TAP_OPT ?= "-netdev tap,id=net0,ifname=@TAP@,script=no,downscript=no"
QB_SLIRP_OPT ?= "-netdev user,id=net0"
QB_OPT_APPEND ?= "-show-cursor -device virtio-rng-device"
# blank out as many redundant args so they don't get misconstrued - we are using u-boot BOOTCOMMAND instead
QB_DTB ?= ""
QB_KERNEL_ROOT ?= ""
# Overwrite virtio-net-pci defined in oe-core/meta/classes/qemuboot.bbclass,
# since vexpress does not support it.
QB_NETWORK_DEVICE ?= "-device virtio-net-device,netdev=net0,mac=@MAC@"
```

## wic/qemuarma9-yocto.wks
```
# short-description: Create SD card image for vexpress-a9
# long-description: Creates a partitioned SD card image for vexpress-a9.

part /boot --source bootimg-partition --ondisk mmcblk0 --fstype=vfat --label boot --align 4096 --extra-space 6 --active --use-uuid --sourceparams="loader=u-boot"
part / --source rootfs --ondisk mmcblk0 --fstype=ext4 --label root --align 4096 --use-uuid
```
